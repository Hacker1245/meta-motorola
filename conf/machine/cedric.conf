## conf/machine/cedric.conf
```bitbake
#-----------------------------------------------------------------------------
#@TYPE: Machine
#@NAME: Motorola G5 (codename cedric)
#@DESCRIPTION: Machine configuration for the Motorola G5
#-----------------------------------------------------------------------------

require conf/machine/include/tune-cortexa8.inc
require conf/machine/include/meta-android-halium.inc

PREFERRED_PROVIDER_virtual/kernel ?= "linux-motorola-cedric"
MACHINE_KERNEL_PR = "r0"

MACHINE_FEATURES = "apm alsa bluetooth gps usbgadget usbhost phone wifi vfat ext2 keyboard"
MACHINE_DISPLAY_WIDTH_PIXELS = "1080"
MACHINE_DISPLAY_HEIGHT_PIXELS = "1920"
MACHINE_DISPLAY_ORIENTATION = "0"
MACHINE_DISPLAY_PPI = "441"

PREFERRED_VERSION_android-headers-halium = "7.1+git%"
VIRTUAL-RUNTIME_android-system-image = "android-system-image-cedric"
ANDROID_HEADERS_DEFINES = "QCOM_BSP QTI_BSP QCOM_HARDWARE"

PREFERRED_PROVIDER_virtual/xserver = "xserver-xorg"
XSERVER = " \
    xserver-xorg \
    xf86-input-evdev \
    xf86-video-fbdev \
"

# We need fsck.vfat for vfat partitions we need to mount
# Also, include the wlan module for the kernel
MACHINE_EXTRA_RDEPENDS = " \
    android-kernel-bootimg \
    dosfstools \
"

KERNEL_IMAGETYPE = "zImage"
IMAGE_FSTYPES += "tar.gz"
IMAGE_ROOTFS_EXTRA_SPACE = "200000"

ANDROID_BOARD_BOOTIMAGE_PARTITION = "/dev/block/mmcblk0p37"
ANDROID_BOARD_SYSTEMIMAGE_PARTITION_SIZE = "3455451136"
ANDROID_BOARD_FLASH_BLOCK_SIZE = "131072"

SERIAL_CONSOLE = "115200 ttyHSL0"
```
